#ifdef ARDUINO_ARCH_ESP32
// AI: below section was generated by an AI
/*
 * Nanoleaf Shapes panels as a WLED usermod.
 *
 * Same bus driver as the earlier TYPE_LEAFBUS core patch, restructured so it needs no changes to
 * WLED itself. WLED renders into whatever LED output is configured; handleOverlayDraw() turns the
 * rendered frame into one colour per panel and a background task pushes them to the panels. With the
 * generated 2D map every panel takes all the cells under it (leafbus_weights.h). The bus is never touched from the WLED loop, so a slow panel chain cannot stall
 * effects.
 *
 * Protocol reference: https://github.com/MyrikLD/LeafBus (PROTOCOL.md, MIT). Two points differ
 * from that document and were verified on real panels:
 *  - bulk pull (C0) replies come in layout-string order (first pair = nearest panel), while bulk
 *    push (E0) chunks are reversed (first chunk = farthest panel)
 *  - the panel hosting the power supply ORs 0x20 into its status byte
 *
 * Hardware: TX drives a tri-state buffer that is only enabled while TX is active, RX listens to
 * the line through a second, always-enabled buffer. The controller therefore hears its own echo,
 * which is checked and stripped. TX stays push-pull: the buffers release the line.
 */
#include "wled.h"
#include "driver/uart.h"
#include "driver/gpio.h"
#include "hal/gpio_ll.h"
#include "leafbus_geometry.h"
#include "leafbus_weights.h"

static constexpr uint8_t  LB_ROOT_DETECT    = 0x00;   // panels note the connector facing the master
static constexpr uint8_t  LB_LAYOUT_DETECT  = 0x80;   // reply: layout string ending in LB_TERMINATOR
static constexpr uint8_t  LB_BULK_PULL      = 0xC0;   // reply: 2 status bytes per panel
static constexpr uint8_t  LB_BULK_PUSH      = 0xE0;   // colour for every panel, no reply
static constexpr uint8_t  LB_GLOBAL_CMD     = 0xFC;
static constexpr uint8_t  LB_CMD_BRIGHTNESS = 0x04;
static constexpr uint8_t  LB_TERMINATOR     = 0x40;
static constexpr uint8_t  LB_HOTPLUG        = 0xCC;   // trailing byte of a pull reply after a change
static constexpr uint8_t  LB_PSU_CODE       = 1;      // connector-count code of the power supply node
static constexpr uint8_t  LB_TRANSITION     = 1;      // chunk fade time, as LeafBus uses for streaming
static constexpr uint32_t LB_BAUD           = 1000000;
static constexpr uint32_t LB_POLL_MS        = 50;     // stock cadence; unpolled panels apply only the first frame
static constexpr uint32_t LB_MIN_FRAME_MS   = 25;     // at most 40 colour frames per second
static constexpr uint32_t LB_RETRY_MS       = 5000;   // enumeration retry while nothing answers
static constexpr uint32_t LB_REENUM_MS      = 2000;   // enumeration retry after a hot-plug
static constexpr uint32_t LB_LAYOUT_CHECK_MS = 1000;  // re-read the layout this often: an added panel is not reliably reported by CC
static constexpr uint32_t LB_ECHO_MS        = 5;
static constexpr uint32_t LB_LONG_WINDOW_MS = 1500;   // far panels can be slow to relay the layout
static constexpr uint8_t  LB_MISS_LIMIT     = 20;     // unanswered polls before re-enumerating
static constexpr uint8_t  LB_LAYOUT_TRIES   = 6;
static constexpr uint16_t LB_MAX_PANELS     = 64;
static constexpr size_t   LB_MAX_LAYOUT     = 256;
static constexpr size_t   LB_RX_BUFFER      = 1024;
static constexpr int      LB_EXPECT_TERMINATOR = -1;
static constexpr char     LB_LEDMAP[]       = "/ledmap.json";
static constexpr char     LB_MAP_MARK[]     = "\"generator\":\"nanoleaf-shapes\"";   // tags maps written here

// The original ESP32 loses UART2's pin routing shortly after start-up under WLED, so it stays on UART1
#if defined(SOC_UART_HP_NUM) && SOC_UART_HP_NUM > 2 && !defined(CONFIG_IDF_TARGET_ESP32)
static constexpr uart_port_t LB_UART = UART_NUM_2;
#else
static constexpr uart_port_t LB_UART = UART_NUM_1;
#endif

// Board defaults; override per build with -D LEAFBUS_TX_PIN=.. -D LEAFBUS_RX_PIN=..
// Tested on the ESPC5-12 (ESP32-C5) module: TX 26, RX 27.
#ifndef LEAFBUS_TX_PIN
  #define LEAFBUS_TX_PIN 26
#endif
#ifndef LEAFBUS_RX_PIN
  #define LEAFBUS_RX_PIN 27
#endif
// 1 for LeafBus wiring (a resistor straight to the panel's DATA pad, no buffers): TX must release the line
// for the panels to answer.
#ifndef LEAFBUS_OPEN_DRAIN
  #define LEAFBUS_OPEN_DRAIN 0
#endif

class UsermodNanoleafShapes : public Usermod {
  public:
    void setup() override {
      if (enabled) start();
      initDone = true;
    }

    void loop() override {}   // the bus lives in its own task; nothing to do here

    // Called right after the effects have rendered, before the strip is shown: the cheapest place
    // to take a consistent copy of the frame. Only memcpy-grade work happens here.
    void handleOverlayDraw() override {
      if (!running || !_frame) return;
      const unsigned total  = strip.getLengthTotal();
      const unsigned panels = std::min<unsigned>(_panels, LB_MAX_PANELS);   // sampled once: the task may change it
      if (!panels) return;
      const unsigned bri = strip.getBrightness() + 1;
      // The render buffer holds colours before gamma: show() applies it on the way to the physical outputs, so
      // the panels need it here, under the same condition.
      const bool gamma = gammaCorrectCol && !(realtimeMode && arlsDisableGammaCorrection && !realtimeOverride);
      if (xSemaphoreTake(_lock, 0) != pdTRUE) return;        // never wait in the render path
      if (weightsMatch(panels)) {
        for (unsigned i = 0; i < panels; i++) {
          uint32_t c = leafbus::samplePanel(_weights, i, [](uint16_t n) { return strip.getPixelColorNoMap(n); });
          if (c && gamma) c = gamma32(c);
          uint8_t *p = _frame + i * 4;
          p[0] = (R(c) * bri) >> 8;
          p[1] = (G(c) * bri) >> 8;
          p[2] = (B(c) * bri) >> 8;
          p[3] = (W(c) * bri) >> 8;
        }
        _framePixels = panels;
        _dirty = true;
        xSemaphoreGive(_lock);
        if (_task) xTaskNotifyGive(_task);
        return;
      }
      // Without a generated map: the render buffer is indexed by matrix cell; walk it through the ledmap the way strip.show() does, so
      // panel i gets the cell that maps to physical LED i. Panels no cell maps to stay black.
      memset(_frame, 0, panels * 4);
      for (unsigned n = 0; n < total; n++) {
        const unsigned led = strip.getMappedPixelIndex(n);
        if (led >= panels) continue;
        uint32_t c = strip.getPixelColorNoMap(n);
        if (c && gamma) c = gamma32(c);
        uint8_t *p = _frame + led * 4;
        p[0] = (R(c) * bri) >> 8;
        p[1] = (G(c) * bri) >> 8;
        p[2] = (B(c) * bri) >> 8;
        p[3] = (W(c) * bri) >> 8;
      }
      _framePixels = panels;
      _dirty = true;
      xSemaphoreGive(_lock);
      if (_task) xTaskNotifyGive(_task);
    }

    void addToJsonInfo(JsonObject &root) override {
      JsonObject user = root["u"];
      if (user.isNull()) user = root.createNestedObject("u");
      JsonArray arr = user.createNestedArray(FPSTR(_name));
      if (!enabled)      arr.add(F("disabled"));
      else if (!running) arr.add(F("init failed"));
      else if (!_panels) arr.add(F("no panels"));
      else { arr.add(_panels); arr.add(F(" panels")); }
    }

    void addToConfig(JsonObject &root) override {
      JsonObject top = root.createNestedObject(FPSTR(_name));
      top[F("enabled")]  = enabled;
      top[F("txPin")]    = txPin;
      top[F("rxPin")]    = rxPin;
      top[F("openDrain")] = openDrain;  // TX open drain, for unbuffered LeafBus wiring
      top[F("autoMap")]  = autoMap;      // maintain /ledmap.json from the panel layout
      top[F("rotation")] = rotation;     // degrees, rotates that map
    }

    bool readFromConfig(JsonObject &root) override {
      JsonObject top = root[FPSTR(_name)];
      if (top.isNull()) return false;
      const bool    wasEnabled = enabled;
      const int8_t  oldTx = txPin, oldRx = rxPin;
      const bool    oldOpenDrain = openDrain;
      getJsonValue(top[F("enabled")],  enabled);
      getJsonValue(top[F("txPin")],    txPin);
      getJsonValue(top[F("rxPin")],    rxPin);
      getJsonValue(top[F("openDrain")], openDrain);
      const bool    oldAutoMap = autoMap;
      getJsonValue(top[F("autoMap")],  autoMap);
      const int16_t oldRotation = rotation;
      getJsonValue(top[F("rotation")], rotation);
      rotation = ((rotation % 360) + 360) % 360;
      if (initDone && (autoMap != oldAutoMap || rotation != oldRotation)) _mapDone = false;
      if (initDone && (enabled != wasEnabled || txPin != oldTx || rxPin != oldRx || openDrain != oldOpenDrain)) {
        stop();
        if (enabled) start();
      }
      return true;
    }

    uint16_t getId() override { return USERMOD_ID_UNSPECIFIED; }

  private:
    // configuration
    bool    enabled  = true;
    int8_t  txPin    = LEAFBUS_TX_PIN;
    int8_t  rxPin    = LEAFBUS_RX_PIN;
    bool    openDrain = LEAFBUS_OPEN_DRAIN;
    bool    autoMap  = true;
    int16_t rotation = 0;

    bool initDone = false;
    bool running  = false;

    uint8_t *_frame = nullptr;            // brightness-scaled RGBW handed to the bus task
    volatile bool     _dirty = false;
    volatile bool     _stop  = false;
    volatile uint16_t _framePixels = 0;
    bool  _pinsAllocated = false;
    bool  _uartInstalled = false;
    TaskHandle_t      _task    = nullptr;
    SemaphoreHandle_t _lock    = nullptr; // guards _frame and _dirty
    SemaphoreHandle_t _stopped = nullptr; // given by the bus task when it exits
    // state below is only touched by the bus task
    volatile uint16_t _panels = 0;        // panels found by the last enumeration, 0 = none
    bool     _hotplug = false;
    uint8_t  _missRun = 0;
    uint32_t _lastPoll = 0, _lastPush = 0, _nextEnum = 0, _lastCheck = 0;
    uint8_t  _layout[LB_MAX_LAYOUT];
    size_t   _layoutLen = 0;
    volatile bool _mapDone = false;       // cleared by a settings change from the web server task
    leafbus::WeightTable _weights;        // guarded by _lock; empty without a generated map

    static const char _name[];

    void start() {
      if (running || txPin < 0 || rxPin < 0) return;
      managed_pin_type pins[2] = {{txPin, true}, {rxPin, false}};
      _pinsAllocated = PinManager::allocateMultiplePins(pins, 2, PinOwner::UM_Unspecified);
      if (!_pinsAllocated) { DEBUG_PRINTLN(F("LeafBus: pins in use")); return; }

      _frame   = (uint8_t*)calloc(LB_MAX_PANELS, 4);
      _lock    = xSemaphoreCreateMutex();
      _stopped = xSemaphoreCreateBinary();
      if (!_frame || !_lock || !_stopped) { stop(); return; }

      uart_config_t cfg = {};
      cfg.baud_rate = LB_BAUD;
      cfg.data_bits = UART_DATA_8_BITS;
      cfg.parity    = UART_PARITY_DISABLE;
      cfg.stop_bits = UART_STOP_BITS_1;
      cfg.flow_ctrl = UART_HW_FLOWCTRL_DISABLE;
      #if ESP_IDF_VERSION_MAJOR >= 5
      cfg.source_clk = UART_SCLK_DEFAULT;
      #else
      cfg.source_clk = UART_SCLK_APB;
      #endif
      _stop = false;
      _uartInstalled = uart_driver_install(LB_UART, LB_RX_BUFFER, 0, 0, nullptr, 0) == ESP_OK;
      if (!_uartInstalled
          || uart_param_config(LB_UART, &cfg) != ESP_OK
          || uart_set_pin(LB_UART, txPin, rxPin, UART_PIN_NO_CHANGE, UART_PIN_NO_CHANGE) != ESP_OK) {
        stop();
        return;
      }
      // uart_set_pin leaves the pad push-pull; this flips only the pad driver, not the UART routing
      if (openDrain) gpio_ll_od_enable(&GPIO, (gpio_num_t)txPin);
      if (xTaskCreate(taskEntry, "LeafBus", 8192, this, 2, &_task) != pdPASS) {
        _task = nullptr;
        stop();
        return;
      }
      running = true;
      DEBUG_PRINTF_P(PSTR("LeafBus: TX %d, RX %d\n"), txPin, rxPin);
    }

    void stop() {
      running = false;
      if (_task) {
        _stop = true;
        xTaskNotifyGive(_task);
        // the task checks _stop between bus transactions; an enumeration step takes at most ~1.5 s
        if (xSemaphoreTake(_stopped, pdMS_TO_TICKS(3000)) != pdTRUE) vTaskDelete(_task);
        _task = nullptr;
      }
      if (_uartInstalled) { uart_driver_delete(LB_UART); _uartInstalled = false; }
      if (_pinsAllocated) {
        // input with pull-up: TX idles high, so the transmit buffer stays disabled
        gpio_reset_pin((gpio_num_t)txPin);
        gpio_reset_pin((gpio_num_t)rxPin);
        uint8_t p[2] = {(uint8_t)txPin, (uint8_t)rxPin};
        PinManager::deallocateMultiplePins(p, 2, PinOwner::UM_Unspecified);
        _pinsAllocated = false;
      }
      if (_lock)    vSemaphoreDelete(_lock);
      if (_stopped) vSemaphoreDelete(_stopped);
      _lock = _stopped = nullptr;
      free(_frame);
      _frame = nullptr;
      _panels = 0;
      _layoutLen = 0;
    }

    static void taskEntry(void *arg) { static_cast<UsermodNanoleafShapes*>(arg)->run(); }

    void run() {
      while (!_stop) {
        ulTaskNotifyTake(pdTRUE, pdMS_TO_TICKS(5)); // woken by handleOverlayDraw(), else keeps the poll cadence
        if (_stop) break;
        uint32_t now = millis();
        if (_panels == 0 || _hotplug) {
          if ((int32_t)(now - _nextEnum) >= 0) {
            enumerate();
            _nextEnum = millis() + (_panels ? LB_REENUM_MS : LB_RETRY_MS);
          }
          continue;
        }
        if (now - _lastCheck >= LB_LAYOUT_CHECK_MS) {
          _lastCheck = now;
          if (layoutChanged()) {
            _hotplug = true;
            continue;
          }
        }
        if (!_mapDone && _layoutLen) updateLedmap();
        if (_dirty && now - _lastPush >= LB_MIN_FRAME_MS) push();
        if (now - _lastPoll >= LB_POLL_MS) poll();
      }
      xSemaphoreGive(_stopped);
      vTaskDelete(nullptr);
    }

    // Transmit a frame and consume its echo. Returns false if the echo was not our frame.
    bool send(const uint8_t *frame, size_t len) {
      uint8_t echo[32];
      size_t got = 0;
      bool ok = true;
      uart_flush_input(LB_UART);
      uart_write_bytes(LB_UART, frame, len);
      uart_wait_tx_done(LB_UART, pdMS_TO_TICKS(20));
      uint32_t start = millis();
      while (got < len && millis() - start < LB_ECHO_MS + len / 100) {
        int n = uart_read_bytes(LB_UART, echo, std::min(len - got, sizeof(echo)), pdMS_TO_TICKS(1));
        if (n <= 0) continue;
        ok = ok && memcmp(echo, frame + got, n) == 0;
        got += n;
      }
      return ok && got == len;
    }

    // Read a reply until `expect` bytes, the layout terminator or the deadline.
    size_t receive(uint8_t *buf, size_t max, int expect, uint32_t waitMs) {
      size_t limit = (expect > 0 && (size_t)expect < max) ? expect : max;
      size_t n = 0;
      uint32_t start = millis();
      while (n < limit && millis() - start < waitMs && !_stop) {
        int r = uart_read_bytes(LB_UART, buf + n, limit - n, pdMS_TO_TICKS(1));
        if (r <= 0) continue;
        n += r;
        if (expect == LB_EXPECT_TERMINATOR && memchr(buf, LB_TERMINATOR, n)) break;
      }
      return n;
    }

    // Root detect, then layout detect until the same string is read twice: the head of the
    // string can arrive corrupted on big assemblies. Pixel order follows the panel nodes in it.
    void enumerate() {
      static const uint8_t rootDetect[]   = {LB_ROOT_DETECT};
      static const uint8_t layoutDetect[] = {LB_LAYOUT_DETECT};
      static const uint8_t fullBright[]   = {LB_GLOBAL_CMD, LB_CMD_BRIGHTNESS, 0xFF};
      uint8_t cur[LB_MAX_LAYOUT], last[LB_MAX_LAYOUT];
      size_t lastLen = 0;
      bool stable = false;

      for (unsigned i = 0; i < LB_LAYOUT_TRIES && !stable && !_stop; i++) {
        send(rootDetect, sizeof(rootDetect));
        vTaskDelay(pdMS_TO_TICKS(20));
        send(layoutDetect, sizeof(layoutDetect));
        size_t n = receive(cur, sizeof(cur), LB_EXPECT_TERMINATOR, 200 + 40 * (_panels ? _panels : 1));
        if (n == 0) break; // silent: nothing plugged in, or the panels are still starting up
        const uint8_t *end = (const uint8_t*)memchr(cur, LB_TERMINATOR, n);
        if (!end) {
          n += receive(cur + n, sizeof(cur) - n, LB_EXPECT_TERMINATOR, LB_LONG_WINDOW_MS);
          end = (const uint8_t*)memchr(cur, LB_TERMINATOR, n);
          if (!end) continue;
        }
        n = end - cur + 1;
        stable = (n == lastLen && memcmp(cur, last, n) == 0);
        memcpy(last, cur, n);
        lastLen = n;
      }

      uint16_t panels = 0;
      for (size_t i = 0; i + 1 < lastLen; i++) { // the terminator is not a node
        uint8_t b = last[i];
        if ((b & 0x80) && ((b >> 4) & 7) != LB_PSU_CODE && panels < LB_MAX_PANELS) panels++;
      }
      if (panels != _panels) {
        DEBUG_PRINTF_P(PSTR("LeafBus: %u panel(s)%s\n"), panels, stable || !panels ? "" : " (layout unstable)");
      }
      if (stable && panels && (lastLen != _layoutLen || memcmp(last, _layout, lastLen) != 0)) {
        memcpy(_layout, last, lastLen);
        _layoutLen = lastLen;
        _mapDone = false;
      }
      _panels = panels;
      _hotplug = false;
      _missRun = 0;
      if (!_panels) return;

      send(fullBright, sizeof(fullBright)); // WLED scales brightness itself; undo any dimming left by the stock controller
      if (xSemaphoreTake(_lock, pdMS_TO_TICKS(20)) == pdTRUE) {
        _dirty = true; // show the current frame on the (re)found panels
        xSemaphoreGive(_lock);
      }
      _lastPoll = millis();
      if (!_mapDone && _layoutLen) updateLedmap();
    }

    // Root detect and one layout detect, without adopting the result. True if a complete string came back with
    // other panels than the enumerated one. A panel plugged in while running joins only through a fresh 00 + 80.
    bool layoutChanged() {
      static const uint8_t rootDetect[]   = {LB_ROOT_DETECT};
      static const uint8_t layoutDetect[] = {LB_LAYOUT_DETECT};
      uint8_t cur[LB_MAX_LAYOUT];
      if (!_layoutLen) return false;
      send(rootDetect, sizeof(rootDetect));
      vTaskDelay(pdMS_TO_TICKS(20));
      send(layoutDetect, sizeof(layoutDetect));
      size_t n = receive(cur, sizeof(cur), LB_EXPECT_TERMINATOR, 200 + 40 * _panels);
      const uint8_t *end = (const uint8_t*)memchr(cur, LB_TERMINATOR, n);
      if (!end) return false;
      return !sameNodes(cur, end - cur + 1, _layout, _layoutLen);
    }

    // Compares only the node bytes (bit 7 set). In a ring, the separator at the dropped link flips between 04
    // and 05 from one read to the next (protocol-notes.md §4); an added or removed panel always changes the nodes.
    static bool sameNodes(const uint8_t *a, size_t alen, const uint8_t *b, size_t blen) {
      size_t i = 0, j = 0;
      for (;;) {
        while (i < alen && !(a[i] & 0x80)) i++;
        while (j < blen && !(b[j] & 0x80)) j++;
        if (i == alen || j == blen) return i == alen && j == blen;
        if (a[i++] != b[j++]) return false;
      }
    }

    // Keep /ledmap.json in step with the physical layout, so WLED's 2D effects follow the wall: one
    // matrix cell per panel, placed with the LeafBus geometry, gaps elsewhere. A missing map or one
    // written here is replaced; a hand-made one is left alone.
    void updateLedmap() {
      _mapDone = true;
      if (!autoMap) { setWeights(leafbus::WeightTable()); return; }
      leafbus::Panel panels[leafbus::MAX_PANELS];
      uint16_t cells[leafbus::MAX_PANELS];
      uint8_t width = 0, height = 0;
      leafbus::GridTransform xf;
      int n = leafbus::parseLayout(_layout, _layoutLen - 1, panels, leafbus::MAX_PANELS);
      if (n <= 0 || !leafbus::placePanels(panels, n) ||
          !leafbus::gridPanels(panels, n, rotation, width, height, cells, &xf)) {
        DEBUG_PRINTLN(F("LeafBus: layout not mappable to 2D"));
        setWeights(leafbus::WeightTable());
        return;
      }
      leafbus::WeightTable table;
      leafbus::buildWeights(panels, n, rotation, width, height, xf, table);
      setWeights(std::move(table));

      String json;
      json.reserve(128 + 2 * _layoutLen + 4U * width * height);
      json += F("{\"n\":\"Nanoleaf Shapes\",");
      json += LB_MAP_MARK;
      json += F(",\"rot\":");
      json += rotation;
      json += F(",\"layout\":\"");
      for (size_t i = 0; i < _layoutLen; i++) {
        char hex[3];
        snprintf_P(hex, sizeof(hex), PSTR("%02X"), _layout[i]);
        json += hex;
      }
      json += F("\",\"width\":");
      json += width;
      json += F(",\"height\":");
      json += height;
      json += F(",\"map\":["); // must stay the last key: WLED streams the numbers after it
      for (unsigned cell = 0; cell < (unsigned)width * height; cell++) {
        int led = -1;
        for (int i = 0; i < n; i++) if (cells[i] == cell) { led = i; break; }
        if (cell) json += ',';
        json += led;
      }
      json += F("]}");

      if (WLED_FS.exists(LB_LEDMAP)) {
        File f = WLED_FS.open(LB_LEDMAP, "r");
        String old = f ? f.readString() : String();
        f.close();
        if (old == json) return; // already matches this layout
        if (old.indexOf(LB_MAP_MARK) < 0) {
          DEBUG_PRINTLN(F("LeafBus: keeping the hand-made /ledmap.json"));
          setWeights(leafbus::WeightTable());
          return;
        }
      }
      File f = WLED_FS.open(LB_LEDMAP, "w");
      if (!f) return;
      f.print(json);
      f.close();

      strip.suspend();
      strip.waitForIt();
      strip.deserializeMap();       // picks up width and height as well
      strip.makeAutoSegments(true); // segments must span the new matrix
      strip.resume();
      DEBUG_PRINTF_P(PSTR("LeafBus: 2D map %ux%u for %d panels\n"), width, height, n);
    }

    // The table only applies to the matrix it was built for; anything else falls back to one cell per panel.
    bool weightsMatch(unsigned panels) const {
      return _weights.panels.size() == panels && strip.isMatrix &&
             Segment::maxWidth == _weights.width && Segment::maxHeight == _weights.height;
    }

    void setWeights(leafbus::WeightTable &&table) {
      if (xSemaphoreTake(_lock, pdMS_TO_TICKS(100)) != pdTRUE) {
        _mapDone = false; // try again on the next pass
        return;
      }
      std::swap(_weights, table);
      xSemaphoreGive(_lock);
    }

    void poll() {
      static const uint8_t pull[] = {LB_BULK_PULL};
      uint8_t reply[2 * LB_MAX_PANELS + 1];
      const size_t expect = 2 * _panels;

      send(pull, sizeof(pull));
      size_t n = receive(reply, sizeof(reply), expect, 40 + 20 * _panels);
      if (n == expect) n += receive(reply + n, 1, 1, 2); // a hot-plug marker follows the pairs
      _lastPoll = millis();

      if (n > 0 && reply[n - 1] == LB_HOTPLUG && (n - 1) % 2 == 0) {
        _hotplug = true; // re-enumerate: moved panels silently stop applying colour until we do
        return;
      }
      if (n < expect) {
        if (++_missRun >= LB_MISS_LIMIT) _panels = 0; // assembly gone or restarted: enumerate again
      } else {
        _missRun = 0;
      }
    }

    // Chunks run from the far end: chunk i drives the panel at layout position N-1-i.
    void push() {
      uint8_t frame[2 + 6 * LB_MAX_PANELS];
      size_t len = 0;
      if (xSemaphoreTake(_lock, pdMS_TO_TICKS(20)) != pdTRUE) return;
      const unsigned have = _framePixels;
      frame[len++] = LB_BULK_PUSH;
      frame[len++] = 0x03; // constant in every observed frame
      for (unsigned chunk = 0; chunk < _panels; chunk++) {
        unsigned pos = _panels - 1 - chunk;
        if (pos >= have) { // more panels than pixels captured: leave the rest unchanged
          frame[len++] = 0x01;
          frame[len++] = 0xFF;
          continue;
        }
        const uint8_t *p = _frame + pos * 4;
        frame[len++] = 0x05; // chunk length
        frame[len++] = LB_TRANSITION;
        frame[len++] = p[0];
        frame[len++] = p[1];
        frame[len++] = p[2];
        frame[len++] = p[3];
      }
      _dirty = false;
      xSemaphoreGive(_lock);
      send(frame, len);
      _lastPush = millis();
    }
};

const char UsermodNanoleafShapes::_name[] PROGMEM = "NanoleafShapes";

static UsermodNanoleafShapes nanoleaf_shapes;
REGISTER_USERMOD(nanoleaf_shapes);
// AI: end
#endif
